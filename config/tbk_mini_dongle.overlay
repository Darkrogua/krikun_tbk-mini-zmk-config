/*
 * Enable USB CDC ACM UART on nice_nano so CONFIG_ZMK_USB_LOGGING=y works.
 * Mirrors zephyr/boards/common/usb/cdc_acm_serial.dtsi
 */

/ {
    chosen {
        zephyr,console = &board_cdc_acm_uart;
        zephyr,shell-uart = &board_cdc_acm_uart;
        zephyr,uart-mcumgr = &board_cdc_acm_uart;
        zephyr,bt-mon-uart = &board_cdc_acm_uart;
        zephyr,bt-c2h-uart = &board_cdc_acm_uart;
    };
};

&zephyr_udc0 {
    board_cdc_acm_uart: board_cdc_acm_uart {
        compatible = "zephyr,cdc-acm-uart";
    };
};


