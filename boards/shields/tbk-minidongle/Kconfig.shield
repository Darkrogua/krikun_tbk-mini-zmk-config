## boards/shields/tbk-minidongle/Kconfig.shield
```kconfig
# Copyright (c) 2022 Casey Webster, Lau Kar Rui
# SPDX-License-Identifier: MIT

config SHIELD_TBKMINI_LEFT
    def_bool $(shields_list_contains,tbk_mini_left)

config SHIELD_TBKMINI_RIGHT
    def_bool $(shields_list_contains,tbk_mini_right)

config SHIELD_TBKMINI_DONGLE
    def_bool $(shields_list_contains,tbk_mini_dongle)
```

## config/boards/shields/tbk/Kconfig.defconfig
```kconfig
if SHIELD_TBK_CENTRAL_DONGLE

config ZMK_KEYBOARD_NAME
    default "TBK mini"

config ZMK_SPLIT_ROLE_CENTRAL
    default y

endif

if SHIELD_TBK_CENTRAL_DONGLE || SHIELD_TBK_PERIPHERAL_LEFT || SHIELD_TBK_PERIPHERAL_RIGHT

config ZMK_SPLIT
    default y

endif
```

## config/boards/shields/tbk_central_dongle/Kconfig.shield
```kconfig
# Copyright (c) 2020 Pete Johanson
# SPDX-License-Identifier: MIT

config SHIELD_TBK_CENTRAL_DONGLE
    def_bool $(shields_list_contains,tbk_central_dongle)

config SHIELD_TBK_PERIPHERAL_LEFT
    def_bool $(shields_list_contains,tbk_peripheral_left)

config SHIELD_TBK_PERIPHERAL_RIGHT
    def_bool $(shields_list_contains,tbk_peripheral_right)
```

## config/boards/shields/tbk_mini_dongle/Kconfig.shield
```kconfig
# Copyright (c) 2026
# SPDX-License-Identifier: MIT

config SHIELD_TBK_MINI_DONGLE
    def_bool $(shields_list_contains,tbk_mini_dongle)
    select ZMK_SPLIT
    select ZMK_SPLIT_ROLE_CENTRAL
```
